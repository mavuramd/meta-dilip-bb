## conf/layer.conf
```bitbake
# We have a conf and classes directory, append to BBPATH
BBPATH .= ":${LAYERDIR}"

# We have a recipes directory, add to BBFILES
BBFILES += "${LAYERDIR}/recipes*/*/*.bb ${LAYERDIR}/recipes*/*/*.bbappend ${LAYERDIR}/images/*.bb"

BBFILE_COLLECTIONS += "meta-dilip-bb"
BBFILE_PATTERN_meta-dilip-bb := "^${LAYERDIR}/"
BBFILE_PRIORITY_meta-dilip-bb = "16"

LAYERSERIES_COMPAT_meta-dilip-bb = "zeus"
```
